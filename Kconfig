## Kconfig
```kconfig
menu "Application Configuration"
source "ql_application/Kconfig"
endmenu

mainmenu "Quec_bk_7231n Configuration"
```

## ql_application/Kconfig
```kconfig
menu "quectel example configuration"

config  ENABLE_QUECTEL_UART_DEMO
	bool "quectel uart demo"
	default n

config  ENABLE_QUECTEL_OSI_DEMO
	bool "quectel osi demo"
	default n

config  ENABLE_QUECTEL_TIMER_DEMO
	bool "quectel timer demo"
	default n

config  ENABLE_QUECTEL_GPIO_DEMO
	bool "quectel gpio demo"
	default n

config  ENABLE_QUECTEL_PWM_DEMO
	bool "quectel pwm demo"
	default n

config  ENABLE_QUECTEL_FLASH_DEMO
	bool "quectel flash demo"
	default n

config  ENABLE_QUECTEL_BLE_CONFIG_NETWORK_DEMO
	bool "quectel ble config netwrok demo"
	default n

config  ENABLE_QUECTEL_WLAN_CONFIG_NETWORK_DEMO
	bool "quectel wlan config network demo"
	default n

endmenu
```

## ql_build/defconfig
```kconfig
#
# Application Configuration
#

#
# quectel example configuration
#
# CONFIG_ENABLE_QUECTEL_UART_DEMO is not set
CONFIG_ENABLE_QUECTEL_OSI_DEMO=y
CONFIG_ENABLE_QUECTEL_TIMER_DEMO=y
CONFIG_ENABLE_QUECTEL_GPIO_DEMO=y
CONFIG_ENABLE_QUECTEL_PWM_DEMO=y
CONFIG_ENABLE_QUECTEL_FLASH_DEMO=y
CONFIG_ENABLE_QUECTEL_BLE_CONFIG_NETWORK_DEMO=y
CONFIG_ENABLE_QUECTEL_WLAN_CONFIG_NETWORK_DEMO=y
# end of quectel example configuration
# end of Application Configuration
```
